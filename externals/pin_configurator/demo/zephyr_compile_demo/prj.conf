## CMakeLists.txt
```
cmake_minimum_required(VERSION 3.20.0)

find_package(Zephyr REQUIRED HINTS $ENV{ZEPHYR_BASE})
project(pin_configurator_codegen_demo)

target_sources(app PRIVATE src/main.c)
```

## prj.conf
```kconfig
# Generated prj.conf is written here during compile validation.
```

## app.overlay
```dts
/* Generated overlay is written here during compile validation. */
```

## src/main.c
```c
#include <zephyr/kernel.h>

int main(void)
{
	return 0;
}
```
