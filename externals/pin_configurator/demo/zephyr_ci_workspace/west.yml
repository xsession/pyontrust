## externals/pin_configurator/demo/zephyr_ci_workspace/west.yml
```yaml
manifest:
  remotes:
    - name: zephyrproject-rtos
      url-base: https://github.com/zephyrproject-rtos
  defaults:
    remote: zephyrproject-rtos
  projects:
    - name: zephyr
      revision: v4.2.0
      import:
        path-prefix: deps
  self:
    path: addmind/deps/pyontrust/externals/pin_configurator/demo/zephyr_ci_workspace
```
