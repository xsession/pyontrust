## CMakeLists.txt
```
cmake_minimum_required(VERSION 3.20.0)

find_package(Zephyr REQUIRED HINTS $ENV{ZEPHYR_BASE})
project(pin_configurator_real_blinky_import)

target_sources(app PRIVATE src/main.c)

include(${CMAKE_CURRENT_SOURCE_DIR}/../../testbench/CMakeLists.txt)
```

## prj.conf
```kconfig
CONFIG_GPIO=y
CONFIG_CONSOLE=y
CONFIG_PRINTK=y
CONFIG_SERIAL=y
CONFIG_UART_CONSOLE=y
```

## boards/lp_mspm0g3507.overlay
```dts
#include <zephyr/dt-bindings/pinctrl/mspm0-pinctrl.h>

&pinctrl {
    uart0_tx_pa10: uart0_tx_pa10 {
        pinmux = <MSP_PINMUX(21, MSPM0_PIN_FUNCTION_2)>;
    };

    uart0_rx_pa11: uart0_rx_pa11 {
        pinmux = <MSP_PINMUX(22, MSPM0_PIN_FUNCTION_2)>;
        input-enable;
    };
};

&uart0 {
    status = "okay";
    pinctrl-0 = <&uart0_tx_pa10 &uart0_rx_pa11>;
    pinctrl-names = "default";
    current-speed = <115200>;
};
```

## src/main.c
```c
#include <zephyr/devicetree.h>
#include <zephyr/drivers/gpio.h>
#include <zephyr/kernel.h>
#include <zephyr/sys/printk.h>

#define LED0_NODE DT_ALIAS(led0)
#define SLEEP_TIME_MS 1000

#if DT_NODE_HAS_STATUS(LED0_NODE, okay)
static const struct gpio_dt_spec led = GPIO_DT_SPEC_GET(LED0_NODE, gpios);
#endif

int main(void)
{
    printk("Pin Configurator demo boot\n");

#if DT_NODE_HAS_STATUS(LED0_NODE, okay)
    if (!gpio_is_ready_dt(&led)) {
        printk("LED0 not ready\n");
    } else if (gpio_pin_configure_dt(&led, GPIO_OUTPUT_ACTIVE) < 0) {
        printk("LED0 configure failed\n");
    }
#endif

    while (1) {
#if DT_NODE_HAS_STATUS(LED0_NODE, okay)
        gpio_pin_toggle_dt(&led);
#endif
        printk("Blink\n");
        k_msleep(SLEEP_TIME_MS);
    }

    return 0;
}
```
