## CMakeLists.txt
```
cmake_minimum_required(VERSION 3.20.0)

find_package(Zephyr REQUIRED HINTS $ENV{ZEPHYR_BASE})
project(pin_configurator_demo)

target_sources(app PRIVATE src/main.c)
target_include_directories(app PRIVATE include)

include(${CMAKE_CURRENT_SOURCE_DIR}/cmake/testbench.cmake)
```

## prj.conf
```kconfig
# Auto-generated by Zephyr Pin Configurator
CONFIG_BME280=y
CONFIG_CLOCK_CONTROL=y
CONFIG_GPIO=y
CONFIG_I2C=y
CONFIG_SENSOR=y
CONFIG_SERIAL=y
CONFIG_UART_CONSOLE=y
CONFIG_CONSOLE=y
CONFIG_PRINTK=y
```

## src/main.c
```c
#include <zephyr/kernel.h>
#include <zephyr/sys/printk.h>

#include "generated_project_summary.h"

int main(void)
{
	printk("Pin Configurator demo boot\n");
	printk("Board: %s\n", PINCFG_DEMO_BOARD);
	printk("Pins configured: %d\n", PINCFG_DEMO_PIN_COUNT);
	printk("Enabled peripherals: %s\n", PINCFG_DEMO_ENABLED_PERIPHERALS);
	printk("Selected external devices: %s\n", PINCFG_DEMO_SELECTED_DEVICES);
	while (1) {
		k_msleep(1000);
	}
	return 0;
}
```

## include/generated_project_summary.h
```c
#pragma once

#define PINCFG_DEMO_BOARD "lp_mspm0g3507"
#define PINCFG_DEMO_PIN_COUNT 4
#define PINCFG_DEMO_ENABLED_PERIPHERALS "gpioa, i2c0, uart0"
#define PINCFG_DEMO_SELECTED_DEVICES "bme280_i2c"
```
